## conf/layer.conf
```bitbake
# We have a conf and classes directory, add to BBPATH
BBPATH .= ":${LAYERDIR}"

# We have recipes-* directories, add to BBFILES
BBFILES += "${LAYERDIR}/recipes-*/*/*.bb \
            ${LAYERDIR}/recipes-*/*/*.bbappend"

BBFILE_COLLECTIONS += "meta-qt5-config"
BBFILE_PATTERN_meta-qt5-config = "^${LAYERDIR}/"
BBFILE_PRIORITY_meta-qt5-config = "6"

LAYERDEPENDS_meta-qt5-config = "core"
LAYERSERIES_COMPAT_meta-qt5-config = "scarthgap"
```
